## config/west.yml
```yaml
manifest:
  defaults:
    revision: v0.3
  remotes:
    - name: zmkfirmware
      url-base: https://github.com/zmkfirmware
    - name: efogdev
      url-base: https://github.com/efogdev
  projects:
    - name: zmk
      remote: zmkfirmware
      revision: gggw/crosses
      import: app/west.yml
    - name: zmk-pmw3610-driver
      remote: efogdev
      revision: main
    - name: zmk-input-processor-report-rate-limit
      remote: efogdev
      revision: main
  self:
    path: config
```
